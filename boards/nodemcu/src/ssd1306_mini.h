/**
 * Minimal SSD1306/SH1106 I2C driver (no Adafruit / registry deps).
 * Supports 128x32 and 128x64 panels via constructor height.
 *
 * SH1106 (common on 1.3" 128x64 modules) lacks SSD1306's horizontal/vertical
 * addressing mode (cmds 0x20/0x21/0x22) — only page addressing mode (0xB0 +
 * page, then 0x00|low-nibble / 0x10|high-nibble column start) is supported.
 * Without that, every page write lands back on page 0 and only the top
 * rows ever render. This 1.3" 128x64 glass (IdeaElec DST-013 style module)
 * uses the SSD1306 charge pump (0x8D 0x14) and alternative COM (0x12).
 * Sequential COM (0x02) is the 128x32 map and squashes a 64-row image.
 * SH1106 has 132 driver columns vs 128 visible, hence the col_offset
 * (2 is the usual default; nudge if the image is shifted).
 */

#pragma once

#include <Arduino.h>
#include <Wire.h>
#include <stdint.h>
#include <string.h>

#include "alloc.h"

class Ssd1306 {
public:
  /* libc heap is ~2KB after BSS. The framebuffer belongs in the TLSF pool. */
  void *operator new(size_t n) { return os_malloc(n); }
  void operator delete(void *p) { os_free(p); }

  Ssd1306(uint8_t width, uint8_t height, uint8_t addr = 0x3C,
          bool sh1106 = false, uint8_t col_offset = 2)
      : width_(width), height_(height), addr_(addr), pages_(height / 8),
        sh1106_(sh1106), col_offset_(sh1106 ? col_offset : 0) {}

  bool begin() {
    if (width_ != 128 || (height_ != 32 && height_ != 64)) {
      return false;
    }
    /* White, not black: a failed later frame must not leave the glass
     * looking like the controller never came up. sent_ starts as the
     * opposite so the first display() actually pushes the bytes. */
    memset(fb_, 0xFF, sizeof(fb_));
    memset(sent_, 0x00, sizeof(sent_));
    /* 0x12 is the 128x64 alternative-COM map. 0x02 is the 128x32
     * sequential map; on this 64-row glass it draws the picture at the
     * wrong height. */
    const uint8_t com_pins = (height_ == 32) ? 0x02 : 0x12;
    const uint8_t mux = (uint8_t)(height_ - 1);

    if (!cmd(0xAE)) {
      const uint8_t orig = addr_;
      addr_ = (addr_ == 0x3C) ? 0x3D : 0x3C;
      if (!cmd(0xAE)) {
        addr_ = orig;
        cmd(0xAE);
      }
    }
    cmd(0xD5);
    cmd(0x80);
    cmd(0xA8);
    cmd(mux);
    cmd(0xD3);
    cmd(0x00);
    cmd(0x40);
    cmd(0x8D);
    cmd(0x14); // charge pump on — the sequence this panel has shown pixels with
    cmd(0x20);
    cmd(0x00); // same addressing byte as the image that lit this glass
    cmd(0xA1);
    cmd(0xC8);
    cmd(0xDA);
    cmd(com_pins);
    cmd(0x81);
    cmd(0xCF);
    cmd(0xD9);
    cmd(0xF1);
    cmd(0xDB);
    cmd(0x40);
    cmd(0xA4);
    cmd(0xA6);
    cmd(0xAF);
    display();
    return true;
  }

  void clear() { memset(fb_, 0, sizeof(fb_)); }

  void set_pixel(int x, int y, bool on) {
    if (x < 0 || y < 0 || x >= width_ || y >= height_) {
      return;
    }
    const size_t i = (size_t)x + (size_t)(y / 8) * width_;
    if (on) {
      fb_[i] |= (uint8_t)(1u << (y & 7));
    } else {
      fb_[i] &= (uint8_t)~(1u << (y & 7));
    }
  }

  /* 5x7 font, ASCII 32..127 subset — space + digits + letters used by UI */
  void draw_char(int x, int y, char c) {
    if (c < 32 || c > 127) {
      c = '?';
    }
    const uint8_t *g = glyph((uint8_t)c);
    for (int col = 0; col < 5; col++) {
      uint8_t bits = g[col];
      for (int row = 0; row < 7; row++) {
        if (bits & (1u << row)) {
          set_pixel(x + col, y + row, true);
        }
      }
    }
  }

  void draw_text(int x, int y, const char *s) {
    while (*s) {
      draw_char(x, y, *s++);
      x += 6;
    }
  }

  void display() {
    /* Push only pages that changed. A full-frame I2C rewrite scans as a flash.
     */
    for (uint8_t page = 0; page < pages_; page++) {
      uint8_t *row = fb_ + (size_t)page * width_;
      uint8_t *prev = sent_ + (size_t)page * width_;
      if (memcmp(row, prev, width_) == 0) {
        continue;
      }
      if (sh1106_) {
        cmd((uint8_t)(0xB0 + page));                 // page address
        cmd((uint8_t)(0x00 | (col_offset_ & 0x0F))); // column low nibble
        cmd((uint8_t)(0x10 |
                      ((col_offset_ >> 4) & 0x0F))); // column high nibble
      } else {
        cmd(0x21); // column addr
        cmd(0);
        cmd((uint8_t)(width_ - 1));
        cmd(0x22); // single page
        cmd(page);
        cmd(page);
      }

      size_t off = 0;
      while (off < width_) {
        Wire.beginTransmission(addr_);
        Wire.write(0x40); // data
        size_t chunk = (size_t)width_ - off;
        if (chunk > 16) {
          chunk = 16;
        }
        for (size_t i = 0; i < chunk; i++) {
          Wire.write(row[off + i]);
        }
        Wire.endTransmission();
        off += chunk;
      }
      memcpy(prev, row, width_);
    }
  }

private:
  bool cmd(uint8_t c) {
    Wire.beginTransmission(addr_);
    Wire.write(0x00);
    Wire.write(c);
    return Wire.endTransmission() == 0;
  }

  static const uint8_t *glyph(uint8_t c) {
    /* Compact 5-column glyphs for printable ASCII we care about */
    static const uint8_t font[96][5] = {
        {0x00, 0x00, 0x00, 0x00, 0x00}, // sp
        {0x00, 0x00, 0x5F, 0x00, 0x00}, // !
        {0x00, 0x07, 0x00, 0x07, 0x00}, // "
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        {0x00, 0x00, 0x00, 0x00, 0x00}, // DEL
    };
    return font[c - 32];
  }

  uint8_t width_;
  uint8_t height_;
  uint8_t addr_;
  uint8_t pages_;
  bool sh1106_;
  uint8_t col_offset_;
  uint8_t fb_[128 * 8];   // enough for 128x64
  uint8_t sent_[128 * 8]; // last bytes pushed to the panel
};
